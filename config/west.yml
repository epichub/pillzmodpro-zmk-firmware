## config/west.yml
```yaml
manifest:
  remotes:
    # zmk official
    - name: zmkfirmware
      url-base: https://github.com/zmkfirmware
    - name: epichub
      url-base: https://github.com/epichub
  projects:
    - name: zmk
      remote: zmkfirmware
      revision: main
      import: app/west.yml
    - name: pillzmodpro-zmk-module
      remote: epichub
      revision: main
  self:
    path: config
```
